## main/Kconfig.projbuild
```kconfig
menu "ESP32S3 TCP设备框架配置"

    menu "WiFi Configuration"
        config WIFI_SSID
            string "WiFi SSID"
            default "myssid"
            help
                SSID (network name) to connect to.

        config WIFI_PASSWORD
            string "WiFi Password"
            default "mypassword"
            help
                WiFi password (WPA or WPA2) to use.
    endmenu

    menu "TCP Server Configuration"
        config TCP_SERVER_IP
            string "TCP Server IP"
            default "192.168.1.100"
            help
                IP address of the TCP server to connect to.

        config TCP_SERVER_PORT
            int "TCP Server Port"
            default 8080
            help
                Port of the TCP server to connect to.
    endmenu

    menu "Power Management"
        config POWER_SAVE_TIMEOUT
            int "Power Save Timeout (seconds)"
            default 30
            help
                Seconds of inactivity before entering power save mode.
    endmenu

    menu "UART Configuration"
        config UART_PORT
            int "UART Port Number"
            default 1
            range 0 2
            help
                UART port number to use (0-2).

        config UART_BAUD_RATE
            int "UART Baud Rate"
            default 115200
            help
                UART baud rate.

        config UART_TX_PIN
            int "UART TX Pin"
            default 17
            help
                GPIO pin for UART TX.

        config UART_RX_PIN
            int "UART RX Pin"
            default 18
            help
                GPIO pin for UART RX.
    endmenu

    config BATTERY_LOW_THRESHOLD
        int "电池低电量阈值(%)"
        range 5 50
        default 20
        help
            电池低电量阈值百分比。

    config BATTERY_CRITICAL_THRESHOLD
        int "电池严重低电量阈值(%)"
        range 1 20
        default 10
        help
            电池严重低电量阈值百分比。

endmenu 
```

## sdkconfig.defaults
```kconfig
CONFIG_COMPILER_CXX_EXCEPTIONS=y
CONFIG_COMPILER_CXX_RTTI=y
CONFIG_OPTIMIZATION_LEVEL_DEBUG=y
CONFIG_ESP_MAIN_TASK_STACK_SIZE=8192
CONFIG_FREERTOS_HZ=1000
CONFIG_ESPTOOLPY_FLASHMODE_QIO=y
CONFIG_ESPTOOLPY_FLASHFREQ_80M=y 
```
